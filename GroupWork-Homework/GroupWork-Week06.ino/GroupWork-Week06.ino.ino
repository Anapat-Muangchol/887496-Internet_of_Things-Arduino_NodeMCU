//-------- OLED --------
//#include <Arduino.h>
#include <U8g2lib.h>

#ifdef U8X8_HAVE_HW_SPI
#include <SPI.h>
#endif
#ifdef U8X8_HAVE_HW_I2C
#include <Wire.h>
#endif

U8G2_SSD1306_128X64_NONAME_1_SW_I2C u8g2(U8G2_R0, /* clock=*/ SCL, /* data=*/ SDA, /* reset=*/ U8X8_PIN_NONE);   // All Boards without Reset of the Display

//-------- DHT --------
#include <SimpleDHT.h>

#define pinDHT11 D4
SimpleDHT11 dht11;
//----------------------

#define ledPin D3
#define buttonPin D8

#define sun_width 25
#define sun_height 25
static const unsigned char sun_bits[] = {
  0x00, 0x30, 0x00, 0x00, 0x06, 0x30, 0xC0, 0x00, 0x0E, 0x30, 0xE0, 0x00, 
  0x1C, 0x30, 0x70, 0x00, 0x38, 0x00, 0x38, 0x00, 0x30, 0x7C, 0x18, 0x00, 
  0x00, 0xFF, 0x01, 0x00, 0x80, 0xFF, 0x03, 0x00, 0xC0, 0xFF, 0x07, 0x00, 
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  0x00, 0x18, 0x00, 0x00 };

#define snow_width 30
#define snow_height 30
static const unsigned char snow1_bits[] = {
  0x00, 0xE0, 0x01, 0x00, 0x00, 0xF8, 0x07, 0x00, 0x00, 0xFC, 0x0F, 0x00, 
  0x00, 0xCC, 0x0C, 0x00, 0x00, 0xCE, 0x1C, 0x00, 0x00, 0xFE, 0x1F, 0x00, 
  0x00, 0xF6, 0x1B, 0x00, 0x00, 0xCE, 0x1C, 0x00, 0x00, 0x1C, 0x0E, 0x00, 
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  0x00, 0xFC, 0x1F, 0x00, 0x00, 0xF8, 0x0F, 0x00, 0x00, 0xE0, 0x03, 0x00
  };

static const unsigned char snow2_bits[] = {
  0x00, 0xE0, 0x01, 0x00, 0x00, 0xF8, 0x07, 0x00, 0x00, 0xFC, 0x0F, 0x00, 
  0x00, 0xCC, 0x0C, 0x00, 0x00, 0xCE, 0x1C, 0x00, 0x00, 0xFE, 0x1F, 0x00, 
  0x00, 0xF6, 0x1B, 0x00, 0x00, 0xCE, 0x1C, 0x00, 0x00, 0x1C, 0x0E, 0x00, 
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  0x00, 0xFC, 0x1F, 0x00, 0x00, 0xF8, 0x0F, 0x00, 0x00, 0xE0, 0x03, 0x00
  };

byte temperature = 0;
byte humidity = 0;

// Variables will change:
int ledState = HIGH;         // the current state of the output pin
int buttonState;             // the current reading from the input pin
int lastButtonState = LOW;   // the previous reading from the input pin

unsigned long lastDebounceTime = 0;  // the last time the output pin was toggled
unsigned long debounceDelay = 50;    // the debounce time; increase if the output flickers

void setup() {
  Serial.begin(9600);
  u8g2.begin();
  pinMode(ledPin, OUTPUT);
  pinMode(buttonPin, INPUT);
  
  // set initial LED state
  digitalWrite(ledPin, ledState);
  
  //read temperature
  int err = SimpleDHTErrSuccess;
  if ((err = dht11.read(pinDHT11, &temperature, &humidity, NULL)) != SimpleDHTErrSuccess) {
    Serial.print("Read DHT11 failed, err="); Serial.println(err);delay(1000);
    return;
  }
  
}

int xSun = -25;
int cntSnow = 0;
int snowStatus = 0;

void loop() {

  // read the state of the switch into a local variable:
  int reading = digitalRead(buttonPin);

  // If the switch changed, due to noise or pressing:
  if (reading != lastButtonState) {
    // reset the debouncing timer
    lastDebounceTime = millis();
  }

  if ((millis() - lastDebounceTime) > debounceDelay) {
    
    // if the button state has changed:
    if (reading != buttonState) {
      buttonState = reading;

      // only toggle the LED if the new button state is HIGH
      if (buttonState == HIGH) {
        ledState = !ledState;
      }
    }
  }

  // set the LED:
  digitalWrite(ledPin, ledState);
  
  lastButtonState = reading;


  
  
  //read temperature
  if(cntSnow >= 10){
    
    //read temperature
    int err = SimpleDHTErrSuccess;
    if ((err = dht11.read(pinDHT11, &temperature, &humidity, NULL)) != SimpleDHTErrSuccess) {
      Serial.print("Read DHT11 failed, err="); Serial.println(err);delay(1000);
      return;
    }

    Serial.print((int)temperature); Serial.println(" * C");

  }
  
  u8g2.firstPage();
  do {
    
    //print temperature
    u8g2.setFont(u8g2_font_logisoso30_tf);
    u8g2.setCursor(5, 60);
    u8g2.print((int)temperature);
    u8g2.print("*C");
    
    //print the sun
    u8g2.setFont(u8g2_font_ncenB14_tr);
    u8g2.drawXBM(xSun,0, sun_width, sun_height, sun_bits);

    //print snow man
    if(snowStatus == 0){
      u8g2.drawXBM(90,30, snow_width, snow_height, snow1_bits);
      if(cntSnow >= 10){
        snowStatus = 1;
        cntSnow = 0;
      }
    }else{
      u8g2.drawXBM(90,30, snow_width, snow_height, snow2_bits);
      if(cntSnow >= 10){
        snowStatus = 0;
        cntSnow = 0;
      }
    }
    cntSnow++;

  } while ( u8g2.nextPage() );
  
  if(xSun >= 150) xSun = -25;
  xSun++;
  
  delay(5);
}
